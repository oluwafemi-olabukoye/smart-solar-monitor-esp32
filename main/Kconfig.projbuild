## main/Kconfig.projbuild
```kconfig
menu "Solar Monitor IoT"

config WIFI_SSID
    string "Wi-Fi SSID"
    default "myssid"
    help
        SSID of the Wi-Fi AP to connect to.

config WIFI_PASSWORD
    string "Wi-Fi password"
    default "mypassword"
    help
        WPA2 passphrase. Leave empty for open networks (also change
        threshold.authmode in wifi_iot.c to WIFI_AUTH_OPEN).

config IOT_ENDPOINT
    string "HTTP endpoint for JSON upload"
    default "https://webhook.site/c4e2daf1-5408-4d08-8fd4-b195a14f65e2"
    help
        Full URL for the HTTP POST. Supports http:// and https://.

config FIREBASE_ENABLED
    bool "Enable Firebase Realtime Database upload"
    default n
    help
        Publish sensor data to Firebase RTDB via HTTPS PUT every 30 seconds,
        overwriting the node at FIREBASE_PATH with the latest snapshot.

config FIREBASE_HOST
    string "Firebase RTDB base URL"
    default "https://your-project-default-rtdb.firebaseio.com"
    depends on FIREBASE_ENABLED
    help
        Base URL of your Firebase Realtime Database, without a trailing slash.
        Example: https://myproject-default-rtdb.firebaseio.com

config FIREBASE_AUTH_TOKEN
    string "Firebase auth token (leave empty for open rules)"
    default ""
    depends on FIREBASE_ENABLED
    help
        Database Secret or short-lived ID token appended as ?auth=<token>.
        Leave empty only if your RTDB security rules allow unauthenticated writes.

config FIREBASE_PATH
    string "Firebase RTDB path for latest snapshot"
    default "/solar_monitor/latest"
    depends on FIREBASE_ENABLED
    help
        Path within the database to overwrite on each publish. A .json
        extension is appended automatically. Example: /solar_monitor/latest

config OTA_ENABLED
    bool "Enable OTA firmware updates"
    default n
    help
        Poll CONFIG_OTA_URL every 10 minutes for a new firmware binary.

config OTA_URL
    string "OTA firmware binary URL"
    default "http://192.168.1.100:8070/solar_monitor.bin"
    depends on OTA_ENABLED
    help
        URL pointing to the .bin file served by your update server.

endmenu
```

## sdkconfig.defaults
```kconfig
CONFIG_FREERTOS_HZ=1000
CONFIG_ESP_TASK_WDT_TIMEOUT_S=10
CONFIG_ESP_TASK_WDT_INIT=y
CONFIG_ESP_TASK_WDT_PANIC=y
CONFIG_ESP32_BROWNOUT_DET=y
CONFIG_ESP_MAIN_TASK_STACK_SIZE=8192
CONFIG_LOG_DEFAULT_LEVEL_INFO=y
CONFIG_ESPTOOLPY_FLASHSIZE="4MB"
CONFIG_ESPTOOLPY_FLASHSIZE_4MB=y
CONFIG_PARTITION_TABLE_TWO_OTA=y
```
